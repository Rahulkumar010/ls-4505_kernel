/* Extracted from stock LYF LS-4505 boot.img DTB */
&mdss_mdp {
	dsi_ili9806e_txd_fwvga_ips_video: qcom,mdss_dsi_ili9806e_txd_fwvga_ips_video {
				qcom,mdss-dsi-panel-name = "ili9806e txd fwvga ips video mode dsi panel";
				qcom,mdss-dsi-panel-controller = <&mdss_dsi0>;
				qcom,mdss-dsi-panel-type = "dsi_video_mode";
				qcom,mdss-dsi-panel-destination = "display_1";
				qcom,mdss-dsi-panel-framerate = <0x3c>;
				qcom,mdss-dsi-virtual-channel-id = <0x00>;
				qcom,mdss-dsi-stream = <0x00>;
				qcom,mdss-dsi-panel-width = <0x1e0>;
				qcom,mdss-dsi-panel-height = <0x356>;
				qcom,mdss-dsi-h-front-porch = <0x28>;
				qcom,mdss-dsi-h-back-porch = <0x24>;
				qcom,mdss-dsi-h-pulse-width = <0x08>;
				qcom,mdss-dsi-h-sync-skew = <0x00>;
				qcom,mdss-dsi-v-back-porch = <0x0b>;
				qcom,mdss-dsi-v-front-porch = <0x08>;
				qcom,mdss-dsi-v-pulse-width = <0x02>;
				qcom,mdss-dsi-h-left-border = <0x00>;
				qcom,mdss-dsi-h-right-border = <0x00>;
				qcom,mdss-dsi-v-top-border = <0x00>;
				qcom,mdss-dsi-v-bottom-border = <0x00>;
				qcom,mdss-dsi-bpp = <0x18>;
				qcom,mdss-dsi-color-order = "rgb_swap_rgb";
				qcom,mdss-dsi-underflow-color = <0xff>;
				qcom,mdss-dsi-border-color = <0x00>;
				qcom,mdss-dsi-on-command = [39 01 00 00 00 00 06 ff ff 98 06 04 01 39 01 00 00 00 00 02 08 18 39 01 00 00 00 00 02 21 01 39 01 00 00 00 00 02 30 01 39 01 00 00 00 00 02 31 00 39 01 00 00 00 00 02 40 15 39 01 00 00 00 00 02 41 54 39 01 00 00 00 00 02 42 03 39 01 00 00 00 00 02 43 0b 39 01 00 00 00 00 02 44 06 39 01 00 00 00 00 02 46 55 39 01 00 00 00 00 02 50 88 39 01 00 00 00 00 02 51 88 39 01 00 00 00 00 02 52 00 39 01 00 00 00 00 02 53 1f 39 01 00 00 00 00 02 60 07 39 01 00 00 00 00 02 61 00 39 01 00 00 00 00 02 62 07 39 01 00 00 00 00 02 63 00 39 01 00 00 00 00 02 a0 00 39 01 00 00 00 00 02 a1 0d 39 01 00 00 00 00 02 a2 15 39 01 00 00 00 00 02 a3 0e 39 01 00 00 00 00 02 a4 07 39 01 00 00 00 00 02 a5 0d 39 01 00 00 00 00 02 a6 07 39 01 00 00 00 00 02 a7 04 39 01 00 00 00 00 02 a8 08 39 01 00 00 00 00 02 a9 0c 39 01 00 00 00 00 02 aa 10 39 01 00 00 00 00 02 ab 07 39 01 00 00 00 00 02 ac 0d 39 01 00 00 00 00 02 ad 17 39 01 00 00 00 00 02 ae 11 39 01 00 00 00 00 02 af 00 39 01 00 00 00 00 02 c0 00 39 01 00 00 00 00 02 c1 0d 39 01 00 00 00 00 02 c2 15 39 01 00 00 00 00 02 c3 0e 39 01 00 00 00 00 02 c4 07 39 01 00 00 00 00 02 c5 0d 39 01 00 00 00 00 02 c6 07 39 01 00 00 00 00 02 c7 04 39 01 00 00 00 00 02 c8 08 39 01 00 00 00 00 02 c9 0c 39 01 00 00 00 00 02 ca 10 39 01 00 00 00 00 02 cb 07 39 01 00 00 00 00 02 cc 0d 39 01 00 00 00 00 02 cd 17 39 01 00 00 00 00 02 ce 11 39 01 00 00 00 00 02 cf 00 39 01 00 00 00 00 06 ff ff 98 06 04 06 39 01 00 00 00 00 02 00 21 39 01 00 00 00 00 02 01 06 39 01 00 00 00 00 02 02 a0 39 01 00 00 00 00 02 03 02 39 01 00 00 00 00 02 04 01 39 01 00 00 00 00 02 05 01 39 01 00 00 00 00 02 06 80 39 01 00 00 00 00 02 07 03 39 01 00 00 00 00 02 08 06 39 01 00 00 00 00 02 09 80 39 01 00 00 00 00 02 0a 00 39 01 00 00 00 00 02 0b 00 39 01 00 00 00 00 02 0c 20 39 01 00 00 00 00 02 0d 20 39 01 00 00 00 00 02 0e 09 39 01 00 00 00 00 02 0f 00 39 01 00 00 00 00 02 10 ff 39 01 00 00 00 00 02 11 e0 39 01 00 00 00 00 02 12 00 39 01 00 00 00 00 02 13 00 39 01 00 00 00 00 02 14 00 39 01 00 00 00 00 02 15 c0 39 01 00 00 00 00 02 16 08 39 01 00 00 00 00 02 17 00 39 01 00 00 00 00 02 18 00 39 01 00 00 00 00 02 19 00 39 01 00 00 00 00 02 1a 00 39 01 00 00 00 00 02 1b 00 39 01 00 00 00 00 02 1c 00 39 01 00 00 00 00 02 1d 00 39 01 00 00 00 00 02 20 01 39 01 00 00 00 00 02 21 23 39 01 00 00 00 00 02 22 45 39 01 00 00 00 00 02 23 67 39 01 00 00 00 00 02 24 01 39 01 00 00 00 00 02 25 23 39 01 00 00 00 00 02 26 45 39 01 00 00 00 00 02 27 67 39 01 00 00 00 00 02 30 12 39 01 00 00 00 00 02 31 22 39 01 00 00 00 00 02 32 22 39 01 00 00 00 00 02 33 22 39 01 00 00 00 00 02 34 87 39 01 00 00 00 00 02 35 96 39 01 00 00 00 00 02 36 aa 39 01 00 00 00 00 02 37 db 39 01 00 00 00 00 02 38 cc 39 01 00 00 00 00 02 39 bd 39 01 00 00 00 00 02 3a 78 39 01 00 00 00 00 02 3b 69 39 01 00 00 00 00 02 3c 22 39 01 00 00 00 00 02 3d 22 39 01 00 00 00 00 02 3e 22 39 01 00 00 00 00 02 3f 22 39 01 00 00 00 00 02 40 22 39 01 00 00 00 00 02 52 10 39 01 00 00 00 00 02 53 10 39 01 00 00 00 00 06 ff ff 98 06 04 07 39 01 00 00 00 00 02 02 77 39 01 00 00 00 00 02 e1 79 39 01 00 00 00 00 02 18 1d 39 01 00 00 00 00 02 26 b2 39 01 00 00 00 00 06 ff ff 98 06 04 00 39 01 00 00 00 00 02 36 00 39 01 00 00 78 00 02 11 00 39 01 00 00 78 00 02 29 00];
				qcom,mdss-dsi-off-command = [05 01 00 00 32 00 02 28 00 05 01 00 00 78 00 02 10 00];
				qcom,mdss-dsi-on-command-state = "dsi_lp_mode";
				qcom,mdss-dsi-off-command-state = "dsi_hs_mode";
				qcom,mdss-dsi-h-sync-pulse = <0x01>;
				qcom,mdss-dsi-traffic-mode = "burst_mode";
				qcom,mdss-dsi-bllp-eof-power-mode;
				qcom,mdss-dsi-bllp-power-mode;
				qcom,mdss-dsi-lane-0-state;
				qcom,mdss-dsi-lane-1-state;
				qcom,mdss-dsi-panel-timings = <0x6a160e00 0x383c121a 0x10030400>;
				qcom,mdss-dsi-t-clk-post = <0x04>;
				qcom,mdss-dsi-t-clk-pre = <0x23>;
				qcom,mdss-dsi-bl-min-level = <0x01>;
				qcom,mdss-dsi-bl-max-level = <0xfff>;
				qcom,mdss-dsi-dma-trigger = "trigger_sw";
				qcom,mdss-dsi-mdp-trigger = "none";
				qcom,mdss-dsi-bl-pmic-control-type = "bl_ctrl_pwm";
				qcom,mdss-dsi-bl-pmic-pwm-frequency = <0x64>;
				qcom,mdss-dsi-bl-pmic-bank-select = <0x00>;
				qcom,mdss-dsi-pwm-gpio = <0x8d 0x02 0x00>;
				qcom,mdss-dsi-reset-sequence = <0x01 0x14 0x00 0x14 0x01 0x78>;
				qcom,cont-splash-enabled;
			};
};
